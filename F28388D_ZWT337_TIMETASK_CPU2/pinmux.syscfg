/**
 * These arguments were used when this file was generated. They will be automatically applied on subsequent loads
 * via the GUI or CLI. Run CLI with '--help' for additional information on how to override these arguments.
 * @cliArgs --device "F2838x" --package "176pin" --part "F2838x_176pin" --context "CPU2" --product "C2000WARE@5.02.00.00"
 * @versions {"tool":"1.20.0+3587"}
 */

/**
 * Import the modules used in this configuration.
 */
const adc       = scripting.addModule("/driverlib/adc.js", {}, false);
const adc1      = adc.addInstance();
const adc2      = adc.addInstance();
const cputimer  = scripting.addModule("/driverlib/cputimer.js", {}, false);
const cputimer1 = cputimer.addInstance();
const epwm      = scripting.addModule("/driverlib/epwm.js", {}, false);
const epwm1     = epwm.addInstance();
const epwm2     = epwm.addInstance();
const epwm3     = epwm.addInstance();
const ipc       = scripting.addModule("/driverlib/ipc.js");

/**
 * Write custom configuration values to the imported modules.
 */
adc1.$name                   = "CPU2_ADCD";
adc1.adcClockPrescaler       = "ADC_CLK_DIV_4_0";
adc1.adcBase                 = "ADCD_BASE";
adc1.interruptPulseMode      = "ADC_PULSE_END_OF_CONV";
adc1.enabledInts             = ["ADC_INT_NUMBER1"];
adc1.enableInterrupt1        = true;
adc1.interrupt1SOCSource     = "ADC_SOC_NUMBER1";
adc1.registerInterrupts      = ["1"];
adc1.adcInt1.enableInterrupt = true;

adc2.$name               = "CPU2_ADCC";
adc2.adcBase             = "ADCC_BASE";
adc2.adcClockPrescaler   = "ADC_CLK_DIV_4_0";
adc2.interruptPulseMode  = "ADC_PULSE_END_OF_CONV";
adc2.enabledInts         = ["ADC_INT_NUMBER1"];
adc2.interrupt1SOCSource = "ADC_SOC_NUMBER1";
adc2.registerInterrupts  = ["1"];
adc2.useInterrupts       = false;

cputimer1.$name          = "SWTIRMER";
cputimer1.cputimerBase   = "CPUTIMER1_BASE";
cputimer1.emulationMode  = "CPUTIMER_EMULATIONMODE_RUNFREE";
cputimer1.timerPrescaler = 3;
cputimer1.timerPeriod    = 50000000;
cputimer1.startTimer     = true;

epwm1.$name = "DAB_PWM7_PRI_AH";

epwm2.$name = "DAB_PWM8_PRI_AL";

epwm3.$name = "DAB_PWM9_2ND";

/**
 * Pinmux solution for unlocked pins/peripherals. This ensures that minor changes to the automatic solver in a future
 * version of the tool will not impact the pinmux you originally saw.  These lines can be completely deleted in order to
 * re-solve from scratch.
 */
epwm1.epwm.$suggestSolution           = "EPWM3";
epwm1.epwm.epwm_aPin.$suggestSolution = "GPIO4";
epwm1.epwm.epwm_bPin.$suggestSolution = "GPIO5";
epwm2.epwm.$suggestSolution           = "EPWM2";
epwm2.epwm.epwm_aPin.$suggestSolution = "GPIO2";
epwm2.epwm.epwm_bPin.$suggestSolution = "GPIO3";
epwm3.epwm.$suggestSolution           = "EPWM1";
epwm3.epwm.epwm_aPin.$suggestSolution = "GPIO0";
epwm3.epwm.epwm_bPin.$suggestSolution = "GPIO1";
